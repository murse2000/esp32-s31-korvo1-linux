## esp-buildroot-external/package/esp-hosted-linux/Config.in
```kconfig
config BR2_PACKAGE_ESP_HOSTED_LINUX
	bool "ESP-Hosted-Linux USB driver (ESP32-S31 radio coprocessor)"
	depends on BR2_LINUX_KERNEL
	select BR2_PACKAGE_KMOD
	select BR2_PACKAGE_KMOD_TOOLS
	select BR2_PACKAGE_IW
	select BR2_PACKAGE_WPA_SUPPLICANT
	select BR2_PACKAGE_WPA_SUPPLICANT_NL80211
	help
	  Build Espressif's USB host transport, Wi-Fi and Bluetooth HCI kernel
	  driver plus Wi-Fi tools for a separate ESP32-S31 connected to this board's
	  USB host port. The Korvo-1's integrated radio is not directly exposed as
	  a Linux WLAN/HCI device by the current esp-linux-bsp kernel.
```

## korvo-addons/package/korvo-camera/Config.in
```kconfig
config BR2_PACKAGE_KORVO_CAMERA
	bool "Korvo-1 SC101IOT/OV3660 V4L2 camera"
	depends on BR2_LINUX_KERNEL
```

## korvo-addons/package/korvo-ppa/Config.in
```kconfig
config BR2_PACKAGE_KORVO_PPA
	bool "Korvo-1 PPA and 2D-DMA acceleration"
	depends on BR2_LINUX_KERNEL
```

## korvo-addons/package/korvo-ui/Config.in
```kconfig
config BR2_PACKAGE_KORVO_UI
	bool "Korvo-1 official LVGL demo launcher"
	depends on BR2_INSTALL_LIBSTDCPP
	select BR2_PACKAGE_LVGL
	select BR2_PACKAGE_KORVO_PPA
```

## korvo-addons/package/lvgl-music-demo/Config.in
```kconfig
config BR2_PACKAGE_LVGL_MUSIC_DEMO
	bool "LVGL Korvo-1 music player demo"
	depends on BR2_PACKAGE_LVGL && BR2_PACKAGE_ALSA_UTILS
	select BR2_PACKAGE_ALSA_LIB
	select BR2_PACKAGE_KORVO_PPA
	help
		Touch-enabled LVGL music player with ALSA playback for ESP32-S31-Korvo-1.
```

## korvo-addons/package/lvgl/Config.in
```kconfig
config BR2_PACKAGE_LVGL
	bool "lvgl"
	help
		Lightweight embedded graphics library with Linux framebuffer and evdev drivers.
```

## linux/sound/soc/espressif/Kconfig
```kconfig
# SPDX-License-Identifier: GPL-2.0-only
config SND_SOC_ESP32S31_I2S
	tristate "ESP32-S31 I2S controller"
	depends on SOC_ESP32S31 && OF && DMADEVICES
	select SND_SOC_GENERIC_DMAENGINE_PCM
	help
	  ALSA SoC support for the ESP32-S31 I2S0 and I2S1 controllers.
```
